// Walk_Man.c
// Runs on TM4C123
// Uses ST7735.c LCD.
// Jonathan Valvano
// August 5, 2015
// Possible main program to test the lab
// Feel free to edit this to match your specifications

// Backlight (pin 10) connected to +3.3 V
// MISO (pin 9) unconnected 
// SCK (pin 8) connected to PA2 (SSI0Clk)
// MOSI (pin 7) connected to PA5 (SSI0Tx)
// TFT_CS (pin 6) connected to PA3 (SSI0Fss)
// CARD_CS (pin 5) unconnected
// Data/Command (pin 4) connected to PA6 (GPIO)
// RESET (pin 3) connected to PA7 (GPIO)
// VCC (pin 2) connected to +3.3 V
// Gnd (pin 1) connected to ground

#include <stdio.h>
#include <stdint.h>
#include "string.h"
#include "ST7735.h"
#include "PLL.h"
#include "walking.h"
#include "tm4c123gh6pm.h"

#define SW1       0x10
#define SW2       0x01
#define LED (*((volatile unsigned long *)0x40025038)) 

#define Dark    	0x00
#define Red     	0x02
#define Blue    	0x04
#define Green   	0x08
#define Yellow  	0x0A
#define White   	0x0E
#define Purple  	0x06


const unsigned short sunny[][1024] = {
{
 0xFFFF, 0xFFFF, 0xFFFF, 0xFFFF, 0xFFFF, 0xFFFF, 0xFFFF, 0xFFFF, 0xFFFF, 0xFFFF, 0xFFFF, 0xFFFF, 0xFFFF, 0xFFFF, 0xFFFF, 0xFFFF,
 0xFFFF, 0xFFFF, 0xFFFF, 0xFFFF, 0xFFFF, 0xFFFF, 0xFFFF, 0xFFFF, 0xFFFF, 0xFFFF, 0xFFFF, 0xFFFF, 0xFFFF, 0xFFFF, 0xFFFF, 0xFFFF,
 0xFFFF, 0xFFFF, 0xFFFF, 0xFFFF, 0xFFFF, 0xFFFF, 0xFFFF, 0xFFFF, 0xFFFF, 0xFFFF, 0xFFFF, 0xFFFF, 0xFFFF, 0xFFFF, 0xFFFF, 0xFFFF,
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 0xFFFF, 0xFFFF, 0xFFFF, 0xFFFF, 0xFFFF, 0xFFFF, 0xFFFF, 0xFFFF, 0xFFFF, 0xFFFF, 0xFFFF, 0xFFFF, 0xFFFF, 0xFFFF, 0xFFFF, 0xFFFF,
},
{
 0xFFFF, 0xFFFF, 0xFFFF, 0xFFFF, 0xFFFF, 0xFFFF, 0xFFFF, 0xFFFF, 0xFFFF, 0xFFFF, 0xFFFF, 0xFFFF, 0xFFFF, 0xFFFF, 0xFFFF, 0xFFFF,
 0xFFFF, 0xFFFF, 0xFFFF, 0xFFFF, 0xFFFF, 0xFFFF, 0xFFFF, 0xFFFF, 0xFFFF, 0xFFFF, 0xFFFF, 0xFFFF, 0xFFFF, 0xFFFF, 0xFFFF, 0xFFFF,
 0xFFFF, 0xFFFF, 0xFFFF, 0xFFFF, 0xFFFF, 0xFFFF, 0xFFFF, 0xFFFF, 0xFFFF, 0xFFFF, 0xFFFF, 0xFFFF, 0xFFFF, 0xFFFF, 0xFFFF, 0xFFFF,
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 0xFFFF, 0xFFFF, 0xFFFF, 0xFFFF, 0xFFFF, 0xFFFF, 0xFFFF, 0xFFFF, 0xFFFF, 0xFFFF, 0xFFFF, 0xFFFF, 0xFFFF, 0xFFFF, 0xFFFF, 0xFFFF,
},
};
const unsigned short cloudy[][1024] = {
{0xFFFF, 0xFFFF, 0xFFFF, 0xFFFF, 0xFFFF, 0xFFFF, 0xFFFF, 0xFFFF, 0xFFFF, 0xFFFF, 0xFFFF, 0xFFFF, 0xFFFF, 0xFFFF, 0xFFFF, 0xFFFF,
 0xFFFF, 0xFFFF, 0xFFFF, 0xFFFF, 0xFFFF, 0xFFFF, 0xFFFF, 0xFFFF, 0xFFFF, 0xFFFF, 0xFFFF, 0xFFFF, 0xFFFF, 0xFFFF, 0xFFFF, 0xFFFF,
 0xFFFF, 0xFFFF, 0xFFFF, 0xFFFF, 0xFFFF, 0xFFFF, 0xFFFF, 0xFFFF, 0xFFFF, 0xFFFF, 0xFFFF, 0xFFFF, 0xFFFF, 0xFFFF, 0xFFFF, 0xFFFF,
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 0xFFFF, 0xFFFF, 0xFFFF, 0xFFFF, 0xFFFF, 0xFFFF, 0xFFFF, 0xFFFF, 0xFFFF, 0xFFFF, 0xFFFF, 0xFFFF, 0xFFFF, 0xFFFF, 0xFFFF, 0xFFFF,
},
{
	 0xFFFF, 0xFFFF, 0xFFFF, 0xFFFF, 0xFFFF, 0xFFFF, 0xFFFF, 0xFFFF, 0xFFFF, 0xFFFF, 0xFFFF, 0xFFFF, 0xFFFF, 0xFFFF, 0xFFFF, 0xFFFF,
 0xFFFF, 0xFFFF, 0xFFFF, 0xFFFF, 0xFFFF, 0xFFFF, 0xFFFF, 0xFFFF, 0xFFFF, 0xFFFF, 0xFFFF, 0xFFFF, 0xFFFF, 0xFFFF, 0xFFFF, 0xFFFF,
 0xFFFF, 0xFFFF, 0xFFFF, 0xFFFF, 0xFFFF, 0xFFFF, 0xFFFF, 0xFFFF, 0xFFFF, 0xFFFF, 0xFFFF, 0xFFFF, 0xFFFF, 0xFFFF, 0xFFFF, 0xFFFF,
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 0xFFFF, 0xFFFF, 0xFFFF, 0xFFFF, 0xFFFF, 0xFFFF, 0xFFFF, 0xFFFF, 0xFFFF, 0xFFFF, 0xFFFF, 0xFFFF, 0xFFFF, 0xFFFF, 0xFFFF, 0xFFFF,
}
};

const unsigned short rainy[][1024] = {
{
 0xFFFF, 0xFFFF, 0xFFFF, 0xFFFF, 0xFFFF, 0xFFFF, 0xFFFF, 0xFFFF, 0xFFFF, 0xFFFF, 0xFFFF, 0xFFFF, 0xFFFF, 0xFFFF, 0xFFFF, 0xFFFF,
 0xFFFF, 0xFFFF, 0xFFFF, 0xFFFF, 0xFFFF, 0xFFFF, 0xFFFF, 0xFFFF, 0xFFFF, 0xFFFF, 0xFFFF, 0xFFFF, 0xFFFF, 0xFFFF, 0xFFFF, 0xFFFF,
 0xFFFF, 0xFFFF, 0xFFFF, 0xFFFF, 0xFFFF, 0xFFFF, 0xFFFF, 0xFFFF, 0xFFFF, 0xFFFF, 0xFFFF, 0xFFFF, 0xFFFF, 0xFFFF, 0xFFFF, 0xFFFF,
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 0xFFFF, 0xFFFF, 0xFFFF, 0xFFFF, 0xFFFF, 0xFFFF, 0xFFFF, 0xFFFF, 0xFFFF, 0xFFFF, 0xFFFF, 0xFFFF, 0xFFFF, 0xFFFF, 0xFFFF, 0xFFFF,
},
{
 0xFFFF, 0xFFFF, 0xFFFF, 0xFFFF, 0xFFFF, 0xFFFF, 0xFFFF, 0xFFFF, 0xFFFF, 0xFFFF, 0xFFFF, 0xFFFF, 0xFFFF, 0xFFFF, 0xFFDF, 0xFFDF,
 0xFFFF, 0xFFFF, 0xFFFF, 0xFFFF, 0xFFFF, 0xFFFF, 0xFFFF, 0xFFFF, 0xFFFF, 0xFFFF, 0xFFFF, 0xFFFF, 0xFFFF, 0xFFFF, 0xFFFF, 0xFFFF,
 0xFFFF, 0xFFFF, 0xFFFF, 0xFFFF, 0xFFFF, 0xFFFF, 0xFFFF, 0xFFFF, 0xFFFF, 0xFFFF, 0xFFFF, 0xFFFF, 0xFFFF, 0xFFFF, 0xB5B6, 0x4228,
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 0xFFFF, 0xFFFF, 0xFFFF, 0xFFFF, 0xFFFF, 0xFFFF, 0xFFFF, 0xFFFF, 0xFFFF, 0xFFFF, 0xFFFF, 0xFFFF, 0xFFFF, 0xFFFF, 0xFFFF, 0xFFFF,
},
};

void DelayWait10ms(uint32_t n);
void PortF_Init(void);


uint16_t CLEAR_BG  	=	((31 << 11) | (63 << 5) | 31);
uint16_t CLEAR_FG 	=	((0  << 11) | (0  << 5) | 0);
uint16_t CLOUDY_BG	=	((19 << 11) | (39 << 5) | 19);
uint16_t CLOUDY_FG	= ((31 << 11) | (63 << 5) | 31);
uint16_t RAINY_BG 	= ((0  << 11) | (0  << 5) | 0);
uint16_t RAINY_FG 	= ((25 << 11) | (51 << 5) | 0);

uint8_t DISPLAY = 0;
uint8_t ANIM_IDX = 0;	


int main(void){
	
	PortF_Init();
  PLL_Init(Bus80MHz);
  ST7735_InitR(INITR_REDTAB);

	while(1){
		switch(DISPLAY){
			//Clear
			case 0:
				ST7735_FillRect(0, 0, ST7735_TFTWIDTH, ST7735_TFTHEIGHT/2, CLEAR_BG); 
				ST7735_FillRect(ST7735_TFTWIDTH, ST7735_TFTHEIGHT/2, ST7735_TFTWIDTH, ST7735_TFTHEIGHT, CLOUDY_BG); 
				ST7735_DrawBitmap(32-16, 64, sunny[ANIM_IDX], 32, 32);
				ST7735_DrawString(0, 0, (char *) "Clear", RAINY_FG,  CLEAR_BG, 3);
				ST7735_DrawString(12, 3, (char *) "Min: 70F",  CLEAR_FG,  CLEAR_BG, 1);
				ST7735_DrawString(12, 4, (char *) "Avg: 75F",  CLEAR_FG,  CLEAR_BG, 1);
				ST7735_DrawString(12, 5, (char *) "Max: 80F",  CLEAR_FG,  CLEAR_BG, 1);
				ST7735_DrawString(12, 6, (char *) "Hum: 0%",  CLEAR_FG,  CLEAR_BG, 1);
				ST7735_DrawString(0, 10, (char *)  "Long Beach", ST7735_MAGENTA , RAINY_BG, 2);
				ST7735_DrawString(0, 12, (char *) "CA 90801",  ST7735_MAGENTA, RAINY_BG, 2);
				break;
			case 1:
				ST7735_FillRect(0, 0, ST7735_TFTWIDTH, ST7735_TFTHEIGHT/2, CLEAR_BG); 
				ST7735_FillRect(ST7735_TFTWIDTH, ST7735_TFTHEIGHT/2, ST7735_TFTWIDTH, ST7735_TFTHEIGHT, CLOUDY_BG); 
				ST7735_DrawBitmap(32-16, 64, cloudy[ANIM_IDX], 32, 32);
				ST7735_DrawString(0, 0, (char *) "Cloudy", RAINY_FG,  CLEAR_BG, 3);
				ST7735_DrawString(12, 3, (char *) "Min: 60F",  CLEAR_FG,  CLEAR_BG, 1);
				ST7735_DrawString(12, 4, (char *) "Avg: 65F",  CLEAR_FG,  CLEAR_BG, 1);
				ST7735_DrawString(12, 5, (char *) "Max: 63F",  CLEAR_FG,  CLEAR_BG, 1);
				ST7735_DrawString(12, 6, (char *) "Hum: 50%",  CLEAR_FG,  CLEAR_BG, 1);
				ST7735_DrawString(0, 10, (char *)  "Long Beach", ST7735_MAGENTA , RAINY_BG, 2);
				ST7735_DrawString(0, 12, (char *) "CA 90801",  ST7735_MAGENTA, RAINY_BG, 2);
				break;
			case 2:
				ST7735_FillRect(0, 0, ST7735_TFTWIDTH, ST7735_TFTHEIGHT/2, CLEAR_BG); 
				ST7735_FillRect(ST7735_TFTWIDTH, ST7735_TFTHEIGHT/2, ST7735_TFTWIDTH, ST7735_TFTHEIGHT, CLOUDY_BG); 
				ST7735_DrawBitmap(32-16, 64, rainy[ANIM_IDX], 32, 32);
				ST7735_DrawString(0, 0, (char *) "Rainy", RAINY_FG,  CLEAR_BG, 3);
				ST7735_DrawString(12, 3, (char *) "Min: 60F",  CLEAR_FG,  CLEAR_BG, 1);
				ST7735_DrawString(12, 4, (char *) "Avg: 60F",  CLEAR_FG,  CLEAR_BG, 1);
				ST7735_DrawString(12, 5, (char *) "Max: 60F",  CLEAR_FG,  CLEAR_BG, 1);
				ST7735_DrawString(12, 6, (char *) "Hum: 100%",  CLEAR_FG,  CLEAR_BG, 1);
				ST7735_DrawString(0, 10, (char *)  "Long Beach", ST7735_MAGENTA , RAINY_BG, 2);
				ST7735_DrawString(0, 12, (char *) "CA 90801",  ST7735_MAGENTA, RAINY_BG, 2);
				break;
		}
		DelayWait10ms(1000);
		ANIM_IDX = (ANIM_IDX+1)%2;
	}
} 

// Port F Initialization
void PortF_Init(void){
  SYSCTL_RCGC2_R |= SYSCTL_RCGC2_GPIOF; // (a) activate clock for port F
	while ((SYSCTL_RCGC2_R & SYSCTL_RCGC2_GPIOF)==0){};
  //GPIO_PORTF_LOCK_R = GPIO_LOCK_KEY; // 2) unlock PortF PF0  
  //GPIO_PORTF_CR_R |= 0x10;           // allow changes to PF4,0       
  GPIO_PORTF_DIR_R &= ~0x10;
  GPIO_PORTF_AFSEL_R &= ~0x10;       //     disable alt funct 
  GPIO_PORTF_DEN_R |= 0x10;          //     enable digital   
  GPIO_PORTF_PCTL_R &= ~0x000F0000; // configure as GPIO
  GPIO_PORTF_AMSEL_R &= ~0x10;       //     disable analog functionality on PF
  GPIO_PORTF_PUR_R |= 0x10;     //     enable weak pull-up on PF0,4
		
  GPIO_PORTF_IS_R &= ~0x10;     // (d) PF0,4 is edge-sensitive
  GPIO_PORTF_IBE_R &= ~0x10;    //     PF0,4 is not both edges
  GPIO_PORTF_IEV_R &= ~0x10;    //     PF4 falling edge event
  GPIO_PORTF_ICR_R = 0x10;      // (e) clear flag4
  GPIO_PORTF_IM_R |= 0x10;      // (f) arm interrupt on PF4
  NVIC_PRI7_R = (NVIC_PRI7_R&~0x00E00000)|0x00800000; // (g) priority 4
  NVIC_EN0_R |= 0x40000000;      // (h) enable interrupt 30 in NVIC
		
}

// Subroutine to wait 10 msec
// Inputs: None
// Outputs: None
// Notes: ...
void DelayWait10ms(uint32_t n){uint32_t volatile time;
  while(n){
//    time = 727240*2/91;  // 10msec for launchpad
    time = 727240/91;  // for simulation
    while(time){
	  	time--;
    }
    n--;
  }
}


void GPIOPortF_Handler(void){
	// simple debouncing code: generate 20ms to 30ms delay
	for (uint32_t time=0;time<80000;time++) {}

	if(GPIO_PORTF_RIS_R & SW1)
	{
		GPIO_PORTF_ICR_R = SW1;
		DISPLAY = (DISPLAY+1)%3;
	}
}
